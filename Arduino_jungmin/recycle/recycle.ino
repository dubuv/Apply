#include <SoftwareSerial.h>
#include <talkie.h>

Talkie voice;

const uint8_t sp1[] PROGMEM = {0x00, 0x08, 0xd8, 0xa9, 0x3c, 0x00, 0x2b, 0xb5, 0x27, 0x60, 0x58, 0xd7, 0xc3,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 0xe0, 0xff};

SoftwareSerial BTSerial(6, 7);
// PIR 센서 핀
int pir = 2; 
int led = 13;  
int pirState = LOW;  // PIR 상태 저장 변수
int val = 0;  // PIR 센서에서 읽어온 값
bool sensorActive = false;  // 센서 활성화 상태 플래그

void setup() {
  // 시리얼 통신 (블루투스) 시작
  Serial.begin(9600);
  BTSerial.begin(9600);  

  pinMode(pir, INPUT);  // PIR 센서 핀을 입력 모드로 설정
  pinMode(led, OUTPUT);
  Serial.println("PIR 센서 시스템 준비됨. 명령을 기다리는 중...");

  delay(2000);
}

void loop() {
  // 블루투스를 통해 명령을 받음
  if (BTSerial.available() > 0) {
    char btData = BTSerial.read();
    
    // '1'을 받으면 센서를 활성화
    if (btData == '1') {
      sensorActive = true;
      Serial.println("PIR 센서 활성화됨");
      BTSerial.println("PIR 센서 활성화됨");
    }
    
    // '0'을 받으면 센서를 비활성화
    if (btData == '0') {
      sensorActive = false;
      digitalWrite(led, LOW);
      Serial.println("PIR 센서 비활성화됨");
      BTSerial.println("PIR 센서 비활성화됨");
    }
  }
  
  // 센서가 활성화된 경우에만 PIR 센서 값을 확인
  if (sensorActive) {
    val = digitalRead(pir); 
 
    
    if (val == HIGH) {  // 움직임이 감지된 경우
      if (pirState == LOW) {
        digitalWrite(led, HIGH);
        BTSerial.println("1");
        Serial.println("1");  // 블루투스를 통해 알림 전송
        pirState = HIGH;
        voice.say(sp1);   
      }
      delay(500);
    } else {
      if (pirState == HIGH) {
        digitalWrite(led, LOW);
        BTSerial.println("재활용 실패!");
        Serial.println("재활용 실패!");  // 움직임이 없을 때 알림 전송
        pirState = LOW;
      }
    }
  }
  
}